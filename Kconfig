## Kconfig
```kconfig
menu "sdk config"

config RT_NB_SDK_VERSION
    string "rt-thread nbiot sdk version"
    default "v1.1"
endmenu
```

## board/Kconfig
```kconfig
menu "Hardware Drivers Config"

config MTK_MT2526DA
    bool
    default y

menu "Onboard Peripheral Drivers"

    config BSP_USING_CONSOLE_USART
        bool "Enable console (uart0)"
        select BSP_USING_UART
        select BSP_USING_UART0
        default y

    config BSP_USING_COM1
        bool "Enable COM1 (uart1)"
        select BSP_USING_UART
        select BSP_USING_UART1
        default n

    config BSP_USING_COM2
        bool "Enable COM2 (uart2)"
        select BSP_USING_UART
        select BSP_USING_UART2
        default n

    config NB_PWK_LONGPRESS_SHUTDOWN_ENABLE
        bool "Enable powerkey longpress shutdown mode"
        default y
endmenu

menu "On-chip Peripheral Drivers"

    config BSP_USING_GPIO
        bool "Enable GPIO"
        select RT_USING_PIN
        default y

    menuconfig BSP_USING_UART
        bool "Enable UART"
        default y
        select RT_USING_SERIAL
        if BSP_USING_UART
            config BSP_USING_UART0
                bool "Enable UART0"
                default y

            config BSP_UART0_RX_USING_DMA
                bool "Enable uart0 rx dma mode"
                depends on BSP_USING_UART0 && RT_SERIAL_USING_DMA
                default n

            config BSP_USING_UART1
                bool "Enable UART1"
                default n

            config BSP_UART1_RX_USING_DMA
                bool "Enable uart1 rx dma mode"
                depends on BSP_USING_UART1 && RT_SERIAL_USING_DMA
                default n

            config BSP_USING_UART2
                bool "Enable UART2"
                default n

            config BSP_UART2_RX_USING_DMA
                bool "Enable uart2 rx dma mode"
                depends on BSP_USING_UART2 && RT_SERIAL_USING_DMA
                default n

            config BSP_USING_UART3
                bool "Enable UART3"
                default n

            config BSP_UART3_RX_USING_DMA
                bool "Enable uart3 rx dma mode"
                depends on BSP_USING_UART3 && RT_SERIAL_USING_DMA
                default n
        endif

    config BSP_USING_WDT
        bool "Enable Watchdog"
        select RT_USING_WDT
        default n

    menuconfig BSP_USING_GPT_TIMER
        bool "Enable gpt(general purpose timer) timer"
        select RT_USING_HWTIMER
        default n

        if BSP_USING_GPT_TIMER
            config BSP_USING_GPT0
                # "Enable gpt0", is used for deep sleep
                bool 
                default n
            config BSP_USING_GPT1
                bool "Enable gpt1"
                default n
            config BSP_USING_GPT2
                bool "Enable gpt2"
                default n
        endif

    config BSP_USING_I2C
        bool "Enable i2c"
        select RT_USING_I2C
        default n

    config BSP_USING_I2C0
        bool "Enable i2c0"
        depends on BSP_USING_I2C
        default n
    config BSP_I2C0_FREQUENCY
        int "Config i2c0 frequency (50/100/200/300/400/1000) kbps"
        help
            "Choice one from 50/100/200/300/400/1000 (kbps)"
        depends on BSP_USING_I2C0
        default 400

    config BSP_USING_ADC
        bool "Enable ADC"
        select RT_USING_ADC
        default n

    config BSP_USING_ADC0
        bool "Enable ADC0"
        depends on BSP_USING_ADC
        default n
    config BSP_USING_ADC1
        bool "Enable ADC1"
        depends on BSP_USING_ADC
        default n
    config BSP_USING_ADC2
        # "Enable ADC2", not support M5311
        bool 
        depends on BSP_USING_ADC
        default n
    config BSP_USING_ADC3
        # "Enable ADC3", not support M5311
        bool 
        depends on BSP_USING_ADC
        default n
    config BSP_USING_ADC4
        # "Enable ADC4", not support M5311
        bool 
        depends on BSP_USING_ADC
        default n

    config BSP_USING_PWM
        bool "Enable pwm"
        select RT_USING_PWM
        default n

    config BSP_USING_PWM0
        # "Enable pwm0", not support M5311
        bool 
        depends on BSP_USING_PWM
        default n
    config BSP_USING_PWM0_CLOCK
        int "Config pwm0 clock source (0:13MHZ; 1:32KHZ)"
        help
            0:13MHZ; 1:32KHZ
        depends on BSP_USING_PWM0
        range 0 1
        default 1

    config BSP_USING_PWM1
        # if enable pwm1, i2c0 sda will not to use
        bool "Enable pwm1 (Conflict with i2c0 sda)"
        depends on BSP_USING_PWM
        default n
    config BSP_USING_PWM1_CLOCK
        int "Config pwm1 clock source (0:13MHZ; 1:32KHZ)"
        help
            0:13MHZ; 1:32KHZ
        depends on BSP_USING_PWM1
        range 0 1
        default 1

    config BSP_USING_PWM2
        # "Enable pwm2", not support M5311
        bool 
        depends on BSP_USING_PWM
        default n
    config BSP_USING_PWM2_CLOCK
        int "Config pwm2 clock source (0:13MHZ; 1:32KHZ)"
        help
            0:13MHZ; 1:32KHZ
        depends on BSP_USING_PWM2
        range 0 1
        default 1

    config BSP_USING_PWM3
        bool "Enable pwm3"
        depends on BSP_USING_PWM
        default n
    config BSP_USING_PWM3_CLOCK
        int "Config pwm3 clock source (0:13MHZ; 1:32KHZ)"
        help
            0:13MHZ; 1:32KHZ
        depends on BSP_USING_PWM3
        range 0 1
        default 1

    config BSP_USING_SPI
        bool "Enable spi"
        select RT_USING_SPI
        default n

    config BSP_USING_SPI0
        bool "Enable spi0"
        depends on BSP_USING_SPI
        default n

        choice
            prompt "SPI0 work mode"
            default BSP_USING_SPI0_POLLING_MODE
            depends on BSP_USING_SPI0
            help
                Select SPI0 work mode

            config BSP_USING_SPI0_POLLING_MODE
                bool "Polling mode"

            config BSP_USING_SPI0_DMA_MODE
                bool "DMA mode"

            config BSP_USING_SPI0_DMA_BLOCK_MODE
                bool "DMA blocking mode"
        endchoice

    config BSP_USING_SPI1
        bool "Enable spi1"
        depends on BSP_USING_SPI
        default n

        choice
            prompt "SPI1 work mode"
            default BSP_USING_SPI1_POLLING_MODE
            depends on BSP_USING_SPI1
            help
                Select SPI1 work mode

            config BSP_USING_SPI1_POLLING_MODE
                bool "Polling mode"

            config BSP_USING_SPI1_DMA_MODE
                bool "DMA mode"

            config BSP_USING_SPI1_DMA_BLOCK_MODE
                bool "DMA blocking mode"
        endchoice

    config BSP_USING_ONCHIP_RTC
        bool "Enable rtc device"
        select RT_USING_RTC
        default n

    config BSP_USING_SLEEP_MANAGER
        bool "Enable sleep manager"
        default n

endmenu # "On-chip Peripheral Drivers"
endmenu # "Hardware Drivers Config"
```

## project/nbiot_demo/Kconfig
```kconfig
mainmenu "RT-Thread Configuration"

config BSP_DIR
    string
    option env="BSP_ROOT"
    default "."

config RTT_DIR
    string
    option env="RTT_ROOT"
    default "../../rt-thread"

config PKGS_DIR
    string
    option env="PKGS_ROOT"
    default "packages"

source "$RTT_DIR/Kconfig"
source "$PKGS_DIR/Kconfig"

# board/Kconfig
source "$BSP_DIR/../../board/Kconfig"

# mt2625 Kconfig
source "$BSP_DIR/../../libraries/mt2625/Kconfig"

# NB-IOT samples
source "$BSP_DIR/samples/Kconfig"

source "$BSP_DIR/../../Kconfig"

config RT_NB_DBG_FEATURE
    bool "NB-IOT debug feature"
    default n

config PRJ_USING_NBIOT_DEMO
    bool 
    select NB_USING_LWIP
    select NB_USING_USB
    select NB_USING_NB_MODEM
    select NB_USING_NVDM_MODEM
    select NB_USING_NVDM
    select NB_USING_MTK_PORT_SERVICE
    select NB_USING_TEL_CONN_MGR
    select NB_USING_APB_PROXY
    select NB_USING_RIL
    select NB_USING_NIDD
    select NB_USING_SIMAT_PROXY
    select NB_USING_HDK
    select NB_USING_MUX_AP
    select NB_USING_KERNEL_SERVICE
    default y
```

## project/nbiot_demo/samples/Kconfig
```kconfig
menuconfig RT_USING_NB_SAMPLES
    bool "NB-IOT samples"
    default n

    if RT_USING_NB_SAMPLES
        config NB_GPIO_DEMO
            bool "Enable gpio sample"
            select BSP_USING_GPIO
            default n

        config NB_WDT_DEMO
            bool "Enable watchdog driver sample"
            select BSP_USING_WDT
            default n

        config NB_GPT_DEMO
            bool "Enable gpt timer driver sample"
            select BSP_USING_GPT_TIMER
            select BSP_USING_GPT1
            default n
        
        config NB_ADC_DEMO
            bool "Enable adc driver sample"
            select BSP_USING_ADC
            select BSP_USING_ADC0
            default n

        config NB_PWM_DEMO
            bool "Enable pwm driver sample"
            select BSP_USING_PWM
            select BSP_USING_PWM3
            default n

        config NB_UART_DEMO
            bool "Enable uart sample"
            select BSP_USING_UART
            select BSP_USING_UART0
            select BSP_USING_UART1
            default n

        config NB_LCD_DEMO
            bool "Enable spi lcd driver sample"
            select BSP_USING_SPI
            select BSP_USING_SPI0
            default n

        config NB_TCP_DEMO
            bool "Enable TCP sample"
            default n

        config NB_UDP_DEMO
            bool "Enable UDP sample"
            default n

        config NB_ONENET_DEMO
            bool "Enable onenet sample"
            select NB_USING_ONENET
            default n

        config NB_ONENET_OTA_DEMO
            bool "Enable onenet ota sample"
            select NB_USING_RSFOTA
            default n
    endif
```
